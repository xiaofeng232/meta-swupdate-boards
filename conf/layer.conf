## conf/layer.conf
```bitbake
# We have a conf and classes directory, add to BBPATH
BBPATH .= ":${LAYERDIR}"

# We have recipes-* directories, add to BBFILES
BBFILES += "${LAYERDIR}/recipes-*/*/*.bb \
	${LAYERDIR}/recipes-*/*/*.bbappend"

BBFILE_COLLECTIONS += "swupdate-boards"
BBFILE_PATTERN_swupdate-boards = "^${LAYERDIR}/"
BBFILE_PRIORITY_swupdate-boards = "7"

LAYERDEPENDS_swupdate-boards = "swupdate"

LAYERSERIES_COMPAT_swupdate-boards = "scarthgap"

BBFILES_DYNAMIC += " \
    raspberrypi:${LAYERDIR}/dynamic-layers/raspberrypi/*/*/*.bb \
    raspberrypi:${LAYERDIR}/dynamic-layers/raspberrypi/*/*/*.bbappend \
"

IMAGE_FSTYPES:append = " wic.bz2"
WKS_FILE = "ts-raspberrypi.wks"

IMAGE_INSTALL:append = " \
                    openssh \
                    openssh-sftp-server\
                    network-config \
                    swupdate \
                    swupdate-www \
                    lighttpd \
                     "                        
  
```

## meta-taishan copy/conf/distro/taishan.conf
```bitbake
# Copyright (c) 2025-2026 Taishan Control System. All rights reserved.
#
# Description:
#   A simple Hello World application for demonstration purposes
#
# Authors:
#   Lin Xiaofeng <xiaofeng.lin1@foxmail.com>
#
# Changelog:
#   0.0.1 (2026-01-22):
#     - Initial implementation
#
# License: Closed - Internal Use Only

require conf/distro/poky.conf

DISTRO = "taishan"
DISTRO_NAME = "Taishan Control Linux"
DISTRO_VERSION = "5.0.14"

POKY_INIT_MANAGER = "systemd"
INIT_MANAGER = "systemd"

DISTRO_FEATURES:remove = "opengl wayland vulkan ptest"
DISTRO_FEATURES:append = " systemd usbhost serial"

LICENSE_FLAGS_ACCEPTED:append = " synaptics-killswitch"

PREFERRED_VERSION_linux-yocto ?= "6.6%"
```

## meta-taishan copy/conf/layer.conf
```bitbake
# We have a conf and classes directory, add to BBPATH
BBPATH .= ":${LAYERDIR}"

# We have recipes-* directories, add to BBFILES
BBFILES += "${LAYERDIR}/recipes-*/*/*.bb \
            ${LAYERDIR}/recipes-*/*/*.bbappend"

BBFILE_COLLECTIONS += "meta-taishan"
BBFILE_PATTERN_meta-taishan = "^${LAYERDIR}/"
BBFILE_PRIORITY_meta-taishan = "7"

LAYERDEPENDS_meta-taishan = "core"
LAYERSERIES_COMPAT_meta-taishan = "scarthgap"

INIT_MANAGER = "systemd"
IMAGE_INSTALL:append = " \
    swupdate \
    swupdate-www \
    swupdate-tools \
    u-boot-fw-utils \
    e2fsprogs \
    parted \
"
PACKAGECONFIG:append:pn-swupdate = " json mongoose"
RPI_USE_U_BOOT = "1"
ENABLE_UART = "1"

# WKS_FILE = "sdimage-raspberrypi-taishan.wks"
IMAGE_FSTYPES = "wic.gz wic.bmap ext4.gz wic.bz2"
SWUPDATE_BOOTLOADER = "u-boot"
```

## meta-taishan/conf/distro/taishan.conf
```bitbake
DISTRO_NAME = "taishan"
DISTRO_VERSION = "1.0"
DISTRO_CODENAME = "taishan"

require conf/distro/poky.conf

PACKAGE_CLASSES = "package_deb"
DISTRO_FEATURES += " systemd"
DISTRO_FEATURES:append = " usrmerge"
TCLIBC = "glibc"

PREFERRED_PROVIDER_virtual/kernel = "linux-yocto"
KERNEL_IMAGETYPE = "bzImage"
```

## meta-taishan/conf/layer.conf
```bitbake
# We have a conf and classes directory, add to BBPATH
BBPATH .= ":${LAYERDIR}"

# We have recipes-* directories, add to BBFILES
BBFILES += "${LAYERDIR}/recipes-*/*/*.bb \
            ${LAYERDIR}/recipes-*/*/*.bbappend"

BBFILE_COLLECTIONS += "meta-taishan"
BBFILE_PATTERN_meta-taishan = "^${LAYERDIR}/"
BBFILE_PRIORITY_meta-taishan = "90"

LAYERDEPENDS_meta-taishan = "core"
LAYERSERIES_COMPAT_meta-taishan = "scarthgap"

PACKAGECONFIG:append = " json"
DEPENDS += "json-c"
IMAGE_ROOTFS_SIZE = "2048000"

IMAGE_FSTYPES += "wic wic.bz2"
# WKS_FILE = "raspberrypi4-64-dual-root-data.wks"
PREFERRED_VERSION_linux-raspberrypi = "6.12.%"

IMAGE_INSTALL:append = " \
                    packagegroup-app \
                    packagegroup-network \
                    packagegroup-swupdate \
                    packagegroup-debug \
                     "

IMAGE_INSTALL:append = " \
                    tcpdump \
                    openssh \
                    openssh-sftp-server\
                    network-config \
                    swupdate \
                    swupdate-www \
                    lighttpd \
                     "
```
