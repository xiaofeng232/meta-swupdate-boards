/dts-v1/;
#include "qemux86-64.dts"  // 继承原有设备树

/ {
    #address-cells = <1>;
    #size-cells = <1>;

    /* 新增 GPIO 控制器节点（示例：假设一个虚拟的 GPIO 控制器） */
    gpio@f8000000 {
        compatible = "vendor,gpio-controller";  // 需与内核驱动匹配
        reg = <0xf8000000 0x1000>;  // 基地址和寄存器长度
        #gpio-cells = <2>;  // 表示每个 GPIO 引用需要 2 个参数（pin + flags）
        gpio-controller;  // 标识为 GPIO 控制器
        interrupt-controller;  // 若支持中断
        #interrupt-cells = <2>;
    };

    /* 新增 LED 外设节点（使用上述 GPIO 控制器的引脚 10） */
    led@0 {
        compatible = "gpio-leds";  // 匹配内核的 gpio-leds 驱动
        label = "user-led";
        gpios = <&gpio@f8000000 10 GPIO_ACTIVE_HIGH>;  // 第 10 引脚，高电平有效
        default-state = "off";
    };
};